
const int BUTTON_MANDATA_OK = A0;
int BUTTON_MANDATA_OK_P_STATUS = HIGH;
const int BUTTON_MANDATA_NOK = A1;
int BUTTON_MANDATA_NOK_P_STATUS = LOW;
const int BUTTON_ASPIRAZIONE_OK = A2;
int BUTTON_ASPIRAZIONE_OK_P_STATUS = LOW;
const int BUTTON_ASPIRAZIONE_NOK = A3;
int BUTTON_ASPIRAZIONE_NOK_P_STATUS = LOW;

int INPUT_STATE = LOW;

void setup() {
  Serial.begin(9600);
  pinMode(BUTTON_MANDATA_OK, INPUT);
  pinMode(BUTTON_MANDATA_NOK, INPUT);
  pinMode(BUTTON_ASPIRAZIONE_OK, INPUT);
  pinMode(BUTTON_ASPIRAZIONE_NOK, INPUT);
}

void loop() {
  INPUT_STATE = digitalRead(BUTTON_MANDATA_OK);
  if(INPUT_STATE == LOW && BUTTON_MANDATA_OK_P_STATUS == HIGH){
    Serial.println("MANDATA: OK");
  }
  BUTTON_MANDATA_OK_P_STATUS = INPUT_STATE;
  INPUT_STATE = digitalRead(BUTTON_MANDATA_NOK);
  if(INPUT_STATE == HIGH && BUTTON_MANDATA_NOK_P_STATUS == LOW){
    Serial.println("MANDATA: NOK");
  }
  BUTTON_MANDATA_NOK_P_STATUS = INPUT_STATE;
  INPUT_STATE = digitalRead(BUTTON_ASPIRAZIONE_OK);
  if(INPUT_STATE == HIGH && BUTTON_ASPIRAZIONE_OK_P_STATUS == LOW){
    Serial.println("ASPIRAZIONE: OK");
  }
  BUTTON_ASPIRAZIONE_OK_P_STATUS = INPUT_STATE;
  INPUT_STATE = digitalRead(BUTTON_ASPIRAZIONE_NOK);
  if(INPUT_STATE == HIGH && BUTTON_ASPIRAZIONE_NOK_P_STATUS == LOW){
    Serial.println("ASPIRAZIONE: NOK");
  }
  BUTTON_ASPIRAZIONE_NOK_P_STATUS = INPUT_STATE;


}
